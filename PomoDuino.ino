//Buttons used to control arduino menu & timer - change to match your button pins
#define BUTTON_UP_PIN 6
#define BUTTON_SELECT_PIN 5
#define BUTTON_DOWN_PIN 4
#define BUZZER_PIN 14

//Define session times - change to alter pomodoro session time
const int workTime = 25 * 60;   
const int shortBreak = 5 * 60;  
const int longBreak = 15 * 60;  

// Define session names - change to alter pomodoro session names
const char* workSessionName = "Work Session";
const char* shortBreakName = "Short Break";
const char* longBreakName = "Long Break";



#include "U8glib.h"
#include "pitches.h"

U8GLIB_SSD1306_128X64 u8g(U8G_I2C_OPT_DEV_0 | U8G_I2C_OPT_NO_ACK | U8G_I2C_OPT_FAST);  // Fast I2C / TWI

// 'icon_pomodoro', 16x16px
const unsigned char epd_bitmap_icon_pomodoro[] PROGMEM = {
  0x3f, 0xfc, 0x10, 0x08, 0x1f, 0xf8, 0x08, 0x10, 0x04, 0x20, 0x03, 0xc0, 0x03, 0xc0, 0x01, 0x80,
  0x01, 0x80, 0x02, 0x40, 0x03, 0xc0, 0x05, 0xa0, 0x0b, 0xd0, 0x1f, 0xf8, 0x10, 0x08, 0x3f, 0xfc
};
// 'icon_settings', 16x16px
const unsigned char epd_bitmap_icon_settings[] PROGMEM = {
  0x01, 0x80, 0x02, 0x40, 0x1a, 0x58, 0x24, 0x24, 0x20, 0x04, 0x11, 0x88, 0x62, 0x46, 0x84, 0x21,
  0x84, 0x21, 0x62, 0x46, 0x11, 0x88, 0x20, 0x04, 0x24, 0x24, 0x1a, 0x58, 0x02, 0x40, 0x01, 0x80
};
// 'icon_statistics', 16x16px
const unsigned char epd_bitmap_icon_statistics[] PROGMEM = {
  0x00, 0x00, 0x00, 0x82, 0x08, 0x20, 0x40, 0x80, 0x5c, 0x00, 0x5c, 0x12, 0x5d, 0xc0, 0x5d, 0xc0,
  0x5d, 0xdc, 0x5d, 0xdc, 0x5d, 0xdc, 0x5d, 0xdc, 0x5d, 0xdc, 0x5d, 0xdc, 0xff, 0xff, 0x40, 0x00
};

// 'item_sel_background', 128x21px
const unsigned char epd_bitmap_item_sel_background[] PROGMEM = {
  0x1f, 0xff, 0xff, 0xff, 0xff, 0xff, 0xff, 0xff, 0xff, 0xff, 0xff, 0xff, 0xff, 0xff, 0xff, 0x00,
  0x20, 0x00, 0x00, 0x00, 0x00, 0x00, 0x00, 0x00, 0x00, 0x00, 0x00, 0x00, 0x00, 0x00, 0x00, 0x80,
  0x40, 0x00, 0x00, 0x00, 0x00, 0x00, 0x00, 0x00, 0x00, 0x00, 0x00, 0x00, 0x00, 0x00, 0x00, 0xc0,
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  0x1f, 0xff, 0xff, 0xff, 0xff, 0xff, 0xff, 0xff, 0xff, 0xff, 0xff, 0xff, 0xff, 0xff, 0xff, 0x00
};

// 'Start', 128x64px
const unsigned char epd_bitmap_Start[] PROGMEM = {
  0x00, 0x00, 0x00, 0x00, 0x00, 0x00, 0x00, 0x00, 0x00, 0x00, 0x00, 0x00, 0x00, 0x00, 0x00, 0x00,
  0x00, 0x00, 0x00, 0x00, 0x00, 0x00, 0x00, 0x00, 0x00, 0x00, 0x00, 0x00, 0x00, 0x00, 0x00, 0x00,
  0x00, 0x00, 0x00, 0x00, 0x00, 0x00, 0x00, 0x00, 0x00, 0x00, 0x00, 0x00, 0x00, 0x00, 0x00, 0x00,
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  0x00, 0x00, 0x00, 0x00, 0x00, 0x00, 0x00, 0x00, 0x00, 0x00, 0x00, 0x00, 0x00, 0x00, 0x00, 0x00
};

const unsigned char* bitmap_first[1] = {
  epd_bitmap_Start
};

const unsigned char* bitmap_second[1] = {
  epd_bitmap_Start
};


int button_up_clicked = 0;      //only performs teh action when the button is clicked, and then waits for another press
int button_select_clicked = 0;  //^^^
int button_down_clicked = 0;    //^^^


// Array of all bitmaps for convenience. (Total bytes used to store images in PROGMEM = 144)
const int epd_bitmap_allArray_LEN = 3;
const unsigned char* bitmap_icons[3] = {
  epd_bitmap_icon_pomodoro,
  epd_bitmap_icon_statistics,
  epd_bitmap_icon_settings
};


const int NUM_ITEMS = 3;

char menu_items[NUM_ITEMS][20] = {
  { "Pomodoro" },
  { "Statistics" },
  { "Settings" }
};

int item_selected = 0;  //item currently selected in menu
int item_sel_previous;  //previous item - item before selected item
int item_sel_next;      //next item - item after selected one

int current_screen = 0;  // 0 = menu, 1 = screen, 2 = pomodoro timer



void setup() {
  u8g.setColorIndex(1);
  pinMode(BUTTON_DOWN_PIN, INPUT_PULLUP);
  pinMode(BUTTON_SELECT_PIN, INPUT_PULLUP);
  pinMode(BUTTON_UP_PIN, INPUT_PULLUP);
}



// Variables to track the session state
int workSessionCount = 0;      // Counts how many work sessions have passed
bool isWorkSession = true;     // Starts with a work session
int remainingTime = workTime;  // Start with work session time
int previousTime = 0;

//Buzzer variables
int melody[] = {
  NOTE_C5, NOTE_D5, NOTE_E5, NOTE_F5, NOTE_G5, NOTE_A5, NOTE_B5, NOTE_C6
};


void draw() {
  int minutes = remainingTime / 60;
  int seconds = remainingTime % 60;


  // Display session name
  u8g.setFont(u8g_font_9x15);
  u8g.setPrintPos(10, 15);
  u8g.print(isWorkSession ? workSessionName : (workSessionCount == 4 ? longBreakName : shortBreakName));

  // Display time
  u8g.setFont(u8g_font_fur30n);
  u8g.setPrintPos(15, 60);
  u8g.print(minutes);
  u8g.print(":");

  if (seconds < 10) {
    u8g.print("0");
  }
  u8g.print(seconds);
}






void loop() {

  if (current_screen == 0) {  // MENU SCREEN

    // up and down buttons only work for the menu screen
    if ((digitalRead(BUTTON_UP_PIN) == LOW) && (button_up_clicked == 0)) {  // up button clicked - jump to previous menu item
      item_selected = item_selected - 1;                                    // select previous item
      button_up_clicked = 1;                                                // set button to clicked to only perform the action once
      if (item_selected < 0) {                                              // if first item was selected, jump to last item
        item_selected = NUM_ITEMS - 1;
      }
    } else if ((digitalRead(BUTTON_DOWN_PIN) == LOW) && (button_down_clicked == 0)) {  // down button clicked - jump to next menu item
      item_selected = item_selected + 1;                                               // select next item
      button_down_clicked = 1;                                                         // set button to clicked to only perform the action once
      if (item_selected >= NUM_ITEMS) {                                                // last item was selected, jump to first menu item
        item_selected = 0;
      }
    }

    if ((digitalRead(BUTTON_UP_PIN) == HIGH) && (button_up_clicked == 1)) {  // unclick
      button_up_clicked = 0;
    }
    if ((digitalRead(BUTTON_DOWN_PIN) == HIGH) && (button_down_clicked == 1)) {  // unclick
      button_down_clicked = 0;
    }
  }


  if ((digitalRead(BUTTON_SELECT_PIN) == LOW) && (button_select_clicked == 0)) {  // select button clicked, jump between screens
    button_select_clicked = 1;                                                    // set button to clicked to only perform the action once
    if (current_screen == 0) { current_screen = 1; }                              // menu items screen --> screenshots screen
    else if (current_screen == 1) {
      current_screen = 2;
    }                             // screenshots screen --> qr codes screen
    else { current_screen = 0; }  // qr codes screen --> menu items screen
  }
  if ((digitalRead(BUTTON_SELECT_PIN) == HIGH) && (button_select_clicked == 1)) {  // unclick
    button_select_clicked = 0;
  }

  // set correct values for the previous and next items
  item_sel_previous = item_selected - 1;
  if (item_sel_previous < 0) { item_sel_previous = NUM_ITEMS - 1; }  // previous item would be below first = make it the last
  item_sel_next = item_selected + 1;
  if (item_sel_next >= NUM_ITEMS) { item_sel_next = 0; }  // next item would be after last = make it the first

  u8g.firstPage();
  do {
    if (current_screen == 0) {  //menu screen
      //previous item
      u8g.setFont(u8g_font_7x14);
      u8g.drawStr(28, 15, menu_items[item_sel_previous]);
      u8g.drawBitmapP(4, 2, 2, 16, bitmap_icons[item_sel_previous]);  //draw pomodoro icon

      //current item
      u8g.setFont(u8g_font_7x14Br);
      u8g.drawStr(28, 37, menu_items[item_selected]);
      u8g.drawBitmapP(4, 25, 2, 16, bitmap_icons[item_selected]);  //draw statistics icon

      //next item
      u8g.setFont(u8g_font_7x14);
      u8g.drawStr(28, 58, menu_items[item_sel_next]);
      u8g.drawBitmapP(4, 46, 2, 16, bitmap_icons[item_sel_next]);  //draw settings icon


      u8g.drawBitmapP(0, 22, 128 / 8, 21, epd_bitmap_item_sel_background);
    } else if (current_screen == 1) {
      u8g.drawBitmapP(0, 0, 128 / 8, 64, bitmap_first[item_selected]);  // draw page 1
    } else if (current_screen == 2 && item_selected == 0) {
      draw();
    }
  } while (u8g.nextPage());
  if (current_screen == 2 && item_selected == 0) {
    unsigned long currentTime = millis();
    if (currentTime - previousTime >= 1000) {
      // Decrement the timer
      if (remainingTime > 0) {
        remainingTime--;
      }

      // Check if session ended
      if (remainingTime == 0) {
        if (isWorkSession) {
          workSessionCount++;
        }

        // Switch between work and breaks
        if (isWorkSession) {
          remainingTime = (workSessionCount % 4 == 0) ? longBreak : shortBreak;
        } else {
          remainingTime = workTime;  // After a break, always return to work
        }
        //buzzer after every single session
        tone(BUZZER_PIN, melody[0], 500);
        delay(600);
        tone(BUZZER_PIN, melody[1], 500);
        delay(600);
        tone(BUZZER_PIN, melody[2], 500);
        delay(600);
        tone(BUZZER_PIN, melody[3], 500);

        isWorkSession = !isWorkSession;  // Toggle session type
      }
      previousTime = currentTime;
    }
  }
}
